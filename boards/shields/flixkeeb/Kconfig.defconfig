## boards/shields/flixkeeb/Kconfig.defconfig
```kconfig
if SHIELD_FLIXKEEB_LEFT

config ZMK_KEYBOARD_NAME
    default "FlixKeeb"

config ZMK_SPLIT_ROLE_CENTRAL
    default y

endif

if SHIELD_FLIXKEEB_LEFT || SHIELD_FLIXKEEB_RIGHT

config ZMK_SPLIT
    default y

endif
```

## boards/shields/flixkeeb/Kconfig.shield
```kconfig
config SHIELD_FLIXKEEB_LEFT
    def_bool $(shields_list_contains,flixkeeb_left)

config SHIELD_FLIXKEEB_RIGHT
    def_bool $(shields_list_contains,flixkeeb_right)
```
